## Kconfig
```kconfig
menu "App - Beer Selector"
    menu "Application start"
        config BS_BOOT_SECONDS_WAIT_FOR_KEYPRESS
            int "Boot timeout for ROMMON keypress"
            default 10
            help
                Determines how long to wait before booting. If the user presses the correct key during this time, ROMMON will be started.
        config BS_BOOT_DELAY_AFTER_DOT
            int "Delay after each dot during boot"
            default 100
            help
                How long to wai after printing a dot during boottime. This directly affects the number of dots displayed.
    endmenu

    menu "Default configuration"
        menu "Authentication"
            config BS_CONFIG_AUTH_USER
                string "Username"
                default "bs_ac24_admin"
                help
                    The default username for the project
            config BS_CONFIG_AUTH_PASS
                string "Password"
                default "bs_ac24_admin_password"
                help
                    The default password for the project for the user
            config BS_CONFIG_AUTH_ENABLE
                string "Enable password"
                default "bs_ac24_enable_password"
                help
                    The default enable password for the project
        endmenu

        menu "System"
            config BS_CONFIG_SYS_HOSTNAME
                string "Hostname"
                default "advent2024"
                help
                    The default hostname for the device
        endmenu

        menu "Display"
            config BS_CONFIG_DISPLAY_TIMEOUT
                string "Display timeout"
                default "30"
                help
                    Default timeout for how long each beer is visible (in seconds)
        endmenu

        menu "Logging"
            config BS_CONFIG_LOG_BUFFER_LENGTH
                string "Logging buffer length"
                default "32"
                help
                    Default length for the logging buffer (in items)
            config BS_CONFIG_LOG_BUFFER_SEVERITY
                string "Logging buffer severity"
                default "7"
                help
                    Default max severity for the logging buffer
        endmenu

        menu "Services"
            config BS_CONFIG_SERVICE_UART_LICENSE
                string "UART Licensing service"
                default "0"
                help
                    The default value for the UART Licensing service. 0 = disabled, 1 = enabled
        endmenu
    endmenu

    menu "Normal state"
        config BS_NORMAL_START_TIMEOUT
            int "Start timeout in ms"
            default 750
            help
                The time the login task waits to start. This is to give the logging service time to start

        menu "Logging service"
            config BS_NORMAL_LOGGING_TIMEOUT
                int "Logging timeout in ms"
                default 500
                help
                    How often the logging service checks for new log messages. Lower results in faster logging but less performance.
        endmenu

        menu "Login prompt"
            config BS_LOGIN_INCORRECT_TRIES_BEFORE_LOCK
                int "Incorrect tries before lock"
                default 3
                help
                    The number of incorrect login attempts before the login prompt locks.
            config BS_LOGIN_BLOCKING_TIME
                int "Block time after incorrect login attempts in seconds"
                default 10
                help
                    If a user enters the wrong password too many times, the login prompt will block for this time.
        endmenu
    endmenu

    menu "Misc"
        config BS_OTA_BASE
            string "Web URL where documentation is hosted"
            default "http://mborg.dstark.nl:20241/fw/"
        config BS_DOCUMENTATION_URL
            string "Web URL where documentation is hosted"
            default "http://mborg.dstark.nl:20241/docs/"
    endmenu
endmenu
```
